## boards/arm/beescales_bt/board.yml
```yaml
board:
  name: beescales_bt
  full_name: BeeScales BT
  vendor: nrfmodule
  socs:
    - name: nrf52840
```

## boards/arm/livetracker/board.yml
```yaml
board:
  name: livetracker
  full_name: LiveTracker
  vendor: nrfmodule
  socs:
    - name: nrf52840
    - name: nrf9151
      variants:
        - name: 'ns'
```

## boards/arm/pigeontracker/Kconfig.pigeontracker
```kconfig
# PigeonTracker board configuration
#
# Copyright (c) 2026 nRFModule
# SPDX-License-Identifier: Apache-2.0

config BOARD_PIGEONTRACKER
	select SOC_NRF52840_QIAA if BOARD_PIGEONTRACKER_NRF52840
	select SOC_NRF9151_LACA if BOARD_PIGEONTRACKER_NRF9151 || BOARD_PIGEONTRACKER_NRF9151_NS
```

## boards/arm/pigeontracker/board.yml
```yaml
board:
  name: pigeontracker
  full_name: PigeonTracker
  vendor: nrfmodule
  socs:
    - name: nrf52840
    - name: nrf9151
      variants:
        - name: 'ns'
```

## dts/bindings/gnss/nrfmodule,gnss-nrf91-slm.yaml
```yaml
# Copyright (c) 2026 nRFModule
# SPDX-License-Identifier: Apache-2.0

description: |
  nRF91 modem GNSS exposed through the serial-modem AT bridge (AT#XGNSS).
  Bus-less: the driver is a client of the existing modem AT link and owns
  no peripheral; the node only anchors the driver instance and the `gnss`
  nodelabel.

  The modem AT link must be up before the application powers the GNSS
  session (PM_DEVICE_ACTION_TURN_ON); the driver sends no AT traffic at
  init. API and PM calls block on an AT round-trip.

  Example:

    gnss: gnss-nrf91 {
        compatible = "nrfmodule,gnss-nrf91-slm";
        status = "okay";
    };

compatible: "nrfmodule,gnss-nrf91-slm"

include: base.yaml
```

## lib/adv/Kconfig
```kconfig
# Copyright (c) 2026 nRFModule
# SPDX-License-Identifier: Apache-2.0

config NRFMODULE_ADV_CODEC
	bool "nRFModule BLE advertising wire-format codec"
	help
	  Pure encode/decode for the company-0x0E34 BLE advertising layouts
	  (nRFModule tracker v2 status broadcast, BeeScales hive-scale scan
	  response) plus the Ingics iBS05 temperature beacon (company 0x082C).
	  A single classify/decode entry point disambiguates the two 0x0E34
	  layouts from each other. No Bluetooth stack dependency: any product
	  that needs to read or write these payloads can enable it, including
	  a future BLE hub that scans mixed advertisers.
```

## lib/power/Kconfig
```kconfig
# Copyright (c) 2026 nRFModule
# SPDX-License-Identifier: Apache-2.0

config NRFMODULE_USB_VBUS
	bool "Shared debounced USB VBUS signal"
	default y if USB_DEVICE_STACK_NEXT
	help
	  One debounced VBUS presence signal for the whole image: a pure
	  debounce state machine (nrfmodule_vbus_debounce.h) plus the level
	  store and edge callback the application consumes
	  (nrfmodule_usb_vbus.h). The board layer samples the raw line and
	  publishes the result, so the board USBD gate and the application act
	  on the same edges.

config NRFMODULE_USB_VBUS_APP_OWNED_ENABLE
	bool "Application owns USB enable on debounced VBUS rise"
	depends on NRFMODULE_USB_VBUS
	help
	  Application takes over USB enable on debounced VBUS rise: the board
	  publishes the edge but does not enable USBD, so nothing is exposed to
	  the host until the application calls
	  nrfmodule_usb_vbus_enable_request(). The same holds for a boot with
	  VBUS already present. Use this when work must complete before the host
	  can see the device, for example refreshing the mass-storage FAT image.
	  The board still disables USBD by itself on a debounced VBUS fall.
```

## tests/adv_codec/testcase.yaml
```yaml
tests:
  nrfmodule.adv.codec:
    tags: adv
    platform_allow:
      - qemu_cortex_m0
```

## tests/vbus_debounce/testcase.yaml
```yaml
tests:
  nrfmodule.power.vbus_debounce:
    tags: power
    platform_allow:
      - qemu_cortex_m0
```
