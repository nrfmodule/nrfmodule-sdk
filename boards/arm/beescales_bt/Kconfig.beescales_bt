## boards/arm/beescales_bt/Kconfig.beescales_bt
```kconfig
# Copyright (c) 2026 nRFModule
# SPDX-License-Identifier: Apache-2.0

config BOARD_BEESCALES_BT
	select SOC_NRF52840_QIAA if BOARD_BEESCALES_BT_NRF52840
```

## boards/arm/beescales_bt/Kconfig.defconfig
```kconfig
# Copyright (c) 2026 nRFModule
# SPDX-License-Identifier: Apache-2.0

if BOARD_BEESCALES_BT

config BOARD
	default "beescales_bt"

if BOARD_BEESCALES_BT_NRF52840

config HW_STACK_PROTECTION
	default ARCH_HAS_STACK_PROTECTION

endif # BOARD_BEESCALES_BT_NRF52840

endif # BOARD_BEESCALES_BT
```

## boards/arm/beescales_bt/beescales_bt_nrf52840_defconfig
```kconfig
# Copyright (c) 2026 nRFModule
# SPDX-License-Identifier: Apache-2.0

# Enable MPU
CONFIG_ARM_MPU=y
CONFIG_HW_STACK_PROTECTION=y

# Enable hardware acceleration for crypto
CONFIG_ENTROPY_NRF5_RNG=y

# Enable GPIO
CONFIG_GPIO=y

# Enable USB CDC ACM for console/shell/logging
CONFIG_USB_DEVICE_STACK_NEXT=y
CONFIG_SERIAL=y
CONFIG_UART_USE_RUNTIME_CONFIGURE=y
CONFIG_USBD_CDC_ACM_CLASS=y
CONFIG_CDC_ACM_SERIAL_INITIALIZE_AT_BOOT=y
CONFIG_CDC_ACM_SERIAL_MANUFACTURER_STRING="nRFModule"
CONFIG_CDC_ACM_SERIAL_PRODUCT_STRING="BeeScales BT"
CONFIG_CDC_ACM_SERIAL_PID=0x0006

# Enable I2C for sensors (accelerometer, RTC)
CONFIG_I2C=y
CONFIG_I2C_NRFX=y

# Enable flash subsystem and regulator framework
CONFIG_FLASH=y
CONFIG_REGULATOR=y

# Enable QSPI for external flash (init after regulator-fixed power-up delay)
CONFIG_NORDIC_QSPI_NOR=y
CONFIG_NORDIC_QSPI_NOR_FLASH_LAYOUT_PAGE_SIZE=4096
CONFIG_NORDIC_QSPI_NOR_INIT_PRIORITY=90

# Enable PWM for LED control
CONFIG_PWM=y

# Enable ADC for battery measurement
CONFIG_ADC=y

# Quiet USB subsystem logs by default (apps can override to DBG)
CONFIG_USBD_LOG_LEVEL_WRN=y
CONFIG_UDC_DRIVER_LOG_LEVEL_WRN=y
```

## boards/arm/livetracker/Kconfig.defconfig
```kconfig
# LiveTracker board default configuration
#
# Copyright (c) 2026 nRFModule
# SPDX-License-Identifier: Apache-2.0

if BOARD_LIVETRACKER

config BOARD
	default "livetracker"

if BOARD_LIVETRACKER_NRF52840

config HW_STACK_PROTECTION
	default ARCH_HAS_STACK_PROTECTION

endif # BOARD_LIVETRACKER_NRF52840

if BOARD_LIVETRACKER_NRF9151 || BOARD_LIVETRACKER_NRF9151_NS

config HW_STACK_PROTECTION
	default ARCH_HAS_STACK_PROTECTION

config BOARD_LIVETRACKER
	select USE_DT_CODE_PARTITION if BOARD_LIVETRACKER_NRF9151_NS

endif # BOARD_LIVETRACKER_NRF9151 || BOARD_LIVETRACKER_NRF9151_NS

endif # BOARD_LIVETRACKER
```

## boards/arm/livetracker/Kconfig.livetracker
```kconfig
# LiveTracker board configuration
#
# Copyright (c) 2026 nRFModule
# SPDX-License-Identifier: Apache-2.0

config BOARD_LIVETRACKER
	select SOC_NRF52840_QIAA if BOARD_LIVETRACKER_NRF52840
	select SOC_NRF9151_LACA if BOARD_LIVETRACKER_NRF9151 || BOARD_LIVETRACKER_NRF9151_NS
```

## boards/arm/livetracker/livetracker_nrf52840_defconfig
```kconfig
# SPDX-License-Identifier: Apache-2.0

# Enable MPU
CONFIG_ARM_MPU=y
CONFIG_HW_STACK_PROTECTION=y

# Enable hardware acceleration for crypto
CONFIG_ENTROPY_NRF5_RNG=y

# Enable GPIO
CONFIG_GPIO=y

# Enable UART for serial modem (async API, no hardware flow control)
CONFIG_SERIAL=y
CONFIG_UART_NRFX=y
CONFIG_UART_ASYNC_API=y
CONFIG_UART_0_ASYNC=y
CONFIG_UART_0_INTERRUPT_DRIVEN=n

# Enable USB for console/shell (new USB device stack)
CONFIG_USB_DEVICE_STACK_NEXT=y
CONFIG_UART_USE_RUNTIME_CONFIGURE=y
CONFIG_USBD_CDC_ACM_CLASS=y
CONFIG_CDC_ACM_SERIAL_INITIALIZE_AT_BOOT=y
CONFIG_CDC_ACM_SERIAL_MANUFACTURER_STRING="nRFModule"
CONFIG_CDC_ACM_SERIAL_PRODUCT_STRING="LiveTracker"
CONFIG_CDC_ACM_SERIAL_PID=0x0005
CONFIG_USBD_LOG_LEVEL_WRN=y
CONFIG_UDC_BUF_POOL_SIZE=8192
# Enable I2C for sensors (accelerometer, barometer)
CONFIG_I2C=y
CONFIG_I2C_NRFX=y

# Enable QSPI for external flash
CONFIG_SPI=y
CONFIG_NORDIC_QSPI_NOR=y
```

## boards/arm/livetracker/livetracker_nrf9151_ns_defconfig
```kconfig
# SPDX-License-Identifier: Apache-2.0

# Enable MPU
CONFIG_ARM_MPU=y

# Enable TrustZone-M
CONFIG_ARM_TRUSTZONE_M=y

# This board implies building Non-Secure firmware
CONFIG_TRUSTED_EXECUTION_NONSECURE=y

# Enable GPIO
CONFIG_GPIO=y

# Enable UART for external MCU communication
CONFIG_SERIAL=y
CONFIG_UART_NRFX=y
CONFIG_UART_INTERRUPT_DRIVEN=y
```

## drivers/sensor/bmp390/Kconfig
```kconfig
# Copyright (c) 2026 nRFModule
# SPDX-License-Identifier: Apache-2.0

config NRFMODULE_BMP390
	bool "nRFModule BMP390 driver with power-cycle re-init"
	depends on SENSOR && I2C
	depends on !BMP388
	help
	  Out-of-tree BMP390 (BMP388 family) sensor driver that re-initializes the
	  chip on PM_DEVICE_ACTION_TURN_ON, so it recovers after its power rail is
	  gated via a Zephyr power domain (the stock BMP388 driver has no TURN_ON
	  and wedges after power loss). A faithful copy of the in-tree bmp388 driver
	  plus that one re-init; reuses the in-tree bosch,bmp390 binding/compatible.
	  Mutually exclusive with the stock driver — set CONFIG_BMP388=n.
```

## dts/bindings/gnss/quectel,l76.yaml
```yaml
# Copyright (c) 2026 nRFModule
# SPDX-License-Identifier: Apache-2.0

description: |
  Quectel L76 GNSS receiver with load switch power control.

  The L76 boots at 9600 baud outputting standard NMEA. The driver sends
  PMTK commands to configure sentences and optionally switches to 115200.

  Power is gated by an external load switch (power-gpios). Cutting power
  loses all L76 state; resuming requires a full init sequence including
  baud rate switch.

  Example:

  &uart1 {
          l76: l76 {
                  compatible = "quectel,l76";
                  power-gpios = <&gpio1 2 GPIO_ACTIVE_HIGH>;
                  force-on-gpios = <&gpio0 7 GPIO_ACTIVE_HIGH>;
          };
  };

compatible: "quectel,l76"

include:
  - uart-device.yaml

properties:
  power-gpios:
    type: phandle-array
    required: true
    description: |
      Load switch GPIO that gates power to the L76 module.
      Deassert to cut power completely.

  force-on-gpios:
    type: phandle-array
    description: |
      Force-on pin. Assert to keep L76 awake during normal operation.

  standby-gpios:
    type: phandle-array
    description: |
      Standby control pin for low-power mode that retains state.

  initial-baudrate:
    type: int
    default: 9600
    description: |
      Baud rate the L76 uses at power-on. Always 9600 for L76.

  target-baudrate:
    type: int
    default: 115200
    description: |
      Target baud rate after init. Set to 9600 to skip baud switch.
```

## lib/led/Kconfig
```kconfig
# Copyright (c) 2026 nRFModule
# SPDX-License-Identifier: Apache-2.0

config NRFMODULE_RGB_LED
	bool "nRFModule RGB status-LED engine"
	select LED
	help
	  Priority-arbitrated effect engine for a PWM RGB LED: a pure renderer
	  (led_effect) + priority arbiter (led_arbiter) + the per-instance PWM
	  seam (rgb_led). The product supplies a pwm-leds node and enables
	  CONFIG_LED_PWM / CONFIG_PWM for the backend, then maps its own signals
	  onto arbiter layers.

# Sizes struct led_arbiter, so it must be one value across the whole build —
# a header #define could differ per translation unit and corrupt the struct.
config NRFMODULE_LED_ARBITER_MAX_LAYERS
	int "Max LED arbiter priority layers"
	default 8
	help
	  Number of priority layers a led_arbiter holds (0 = lowest, higher
	  wins). Each slot is small; raise only if a product maps more than 8
	  distinct signals onto one LED.
```

## tests/led_arbiter/testcase.yaml
```yaml
tests:
  nrfmodule.led.arbiter:
    tags: led
    platform_allow:
      - qemu_cortex_m0
```

## tests/led_effect/testcase.yaml
```yaml
tests:
  nrfmodule.led.effect:
    tags: led
    platform_allow:
      - qemu_cortex_m0
```

## west.yml
```yaml
manifest:
  remotes:
    - name: ncs
      url-base: https://github.com/nrfconnect

  projects:
    # This acts as the "Default Recommended Version"
    # It is ignored if the parent manifest defines 'sdk-nrf'
    - name: sdk-nrf
      remote: ncs
      path: nrf
      revision: v3.1.1
      import: true

  self:
    path: modules/lib/nrfmodule-sdk
```
